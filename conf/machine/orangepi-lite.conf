## conf/machine/orangepi-lite.conf
```bitbake
#@TYPE: Machine
#@NAME: OrangePi-Lite
#@DESCRIPTION: Machine configuration for the OrangePi-Lite Board, based on Allwinner H3 CPU #http://orangepi.org/

require conf/machine/include/sun8i.inc

DEFAULTTUNE = "cortexa7hf-neon-vfpv4"

KERNEL_DEVICETREE = "sun8i-h3-orangepi-one.dtb"
UBOOT_MACHINE = "orangepi_one_defconfig"
```
